## board/kendryte/common/k230d/Kconfig
```kconfig
config DDR_K230D
    def_bool n

if DDR_K230D
    choice
        prompt "DDR Type And Frequency"
        default K230D_SIP_LPDDR4_2667

        config K230D_SIP_LPDDR4_1600
            bool "SiP LPDDR4@1600"

        config K230D_SIP_LPDDR4_1600_NODT
            bool "SiP LPDDR4@1600 NODT"

        config K230D_SIP_LPDDR4_2667
            bool "SiP LPDDR4@2667"

        config K230D_SIP_LPDDR4_3200_ALLODT
            bool "SiP LPDDR4@3200 allodt"

        config K230D_SIP_LPDDR4_3200_HWODT
            bool "SiP LPDDR4@3200 hwodt"
    endchoice
endif
```

## board/kendryte/k230_evb/Kconfig
```kconfig
if TARGET_K230_EVB

    config SYS_CPU
        default "k230"

    config SYS_VENDOR
        default "kendryte"

    config SYS_BOARD
        default "k230_evb"

    config SYS_CONFIG_NAME
        default "k230_common"

    config BOARD_SPECIFIC_OPTIONS
        def_bool y
        select KENDRYTE_K230

    choice
        prompt "DDR Type And Frequency"
        default EVB_LPDDR3_2133

        config EVB_LPDDR3_800
            bool "k230 evb lpddr3 800"

        config EVB_LPDDR3_1600
            bool "k230 evb lpddr3 1600"

        config EVB_LPDDR3_2133
            bool "k230 evb lpddr3 2133"

        config EVB_LPDDR4_1066
            bool "k230 evb lpddr4 1066"

        config EVB_LPDDR4_1066_WITHOUT_ODT
            bool "k230 evb lpddr4 1066 without odt"

        config EVB_LPDDR4_2667
            bool "k230 evb lpddr4 2667"

        config EVB_LPDDR4_3200
            bool "k230 evb lpddr4 3200"

        config EVB_K230D_SIP_LPDDR4_2667
            bool "k230d evb lpddr4(sip) 2667"
    endchoice

endif
```

## board/kendryte/k230_labplus_1956/Kconfig
```kconfig
if TARGET_K230_LABPLUS_1956

	config SYS_CPU
		default "k230"

	config SYS_VENDOR
		default "kendryte"

	config SYS_BOARD
		default "k230_labplus_1956"

	config SYS_CONFIG_NAME
		default "k230_common"

	config BOARD_SPECIFIC_OPTIONS
		def_bool y
		select KENDRYTE_K230

	choice
		prompt "DDR Type And Frequency"
		default LABPLUS_1956_LPDDR4_2667

		config LABPLUS_1956_LPDDR4_2667
			bool "LPDDR4@2667"
	endchoice

endif
```
